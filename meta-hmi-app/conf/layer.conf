## meta-hmi-app/conf/layer.conf
```bitbake
# We have a conf and classes directory, append to BBPATH
BBPATH .= ":${LAYERDIR}"

BBFILES += "${LAYERDIR}/recipes-*/*/*.bb ${LAYERDIR}/recipes-*/*/*.bbappend"
# Single-directory image recipes (TASK-108 bundle stub)
BBFILES += "${LAYERDIR}/recipes-images/*.bb ${LAYERDIR}/recipes-images/*.bbappend"

BBFILE_COLLECTIONS += "hmi-app"
BBFILE_PATTERN_hmi-app := "^${LAYERDIR}/"
BBFILE_PRIORITY_hmi-app = "7"

LAYERDEPENDS_hmi-app = "core qt6-layer rauc"
LAYERVERSION_hmi-app = "1"
LAYERSERIES_COMPAT_hmi-app = "scarthgap"
```

## meta-hmi-platform/conf/distro/elevator-hmi.conf
```bitbake
# Elevator HMI — project distro configuration
# Inherits poky distro as base.
require conf/distro/poky.conf

DISTRO = "elevator-hmi"
DISTRO_NAME = "Elevator HMI"
DISTRO_VERSION = "0.1"

# RAUC OTA update support (meta-rauc)
DISTRO_FEATURES:append = " rauc"

# No X11, no Wayland — single application EGLFS HMI
DISTRO_FEATURES:remove = "x11 wayland"

# Development images: empty root password + useful post-install debug hooks (Poky `debug-tweaks`).
# Remove or override for production signing / hardening workflows.
EXTRA_IMAGE_FEATURES += "debug-tweaks"
```

## meta-hmi-platform/conf/layer.conf
```bitbake
# We have a conf and classes directory, append to BBPATH
BBPATH .= ":${LAYERDIR}"

# Recipes will be added in later tasks; keep BBFILES valid for empty layers
BBFILES += "${LAYERDIR}/recipes-*/*/*.bb ${LAYERDIR}/recipes-*/*/*.bbappend"

BBFILE_COLLECTIONS += "hmi-platform"
BBFILE_PATTERN_hmi-platform := "^${LAYERDIR}/"
BBFILE_PRIORITY_hmi-platform = "8"

LAYERDEPENDS_hmi-platform = "core openembedded-layer rockchip"
LAYERVERSION_hmi-platform = "1"
LAYERSERIES_COMPAT_hmi-platform = "scarthgap"
```

## meta-hmi-platform/conf/machine/elevator-hmi-em3566.conf
```bitbake
#@TYPE: Machine
#@NAME: Elevator HMI — Boardcon EM3566 v3 reference (RK3566 + LMT101 on DSI0)
#
# Inherits RK3566 EVB2 LP4X V10 machine tuning from meta-rockchip (Wi‑Fi, U-Boot,
# tune files). Overrides only the kernel DTB to the project Boardcon bring-up DTS
# (TASK-104). Do not edit meta-rockchip — this file lives in meta-hmi-platform.
#
# U-Boot / eMMC (TASK-102): inherits `UBOOT_MACHINE = "rk3568_defconfig"` and
# Rockchip loader packaging from `rockchip-rk3566-evb`. On-chip storage is
# eMMC (mmcblk0). Flash with vendor `rkdeveloptool` / `upgrade_tool` or WIC
# image per `meta-hmi-platform/wic/elevator-hmi-emmc.wks.in` + BSP docs.

require conf/machine/rockchip-rk3566-evb.conf

KERNEL_DEVICETREE = "rockchip/elevator-hmi-boardcon-em3566-v3.dtb"
KERNEL_IMAGETYPE = "Image"
# uboot-extlinux-config.bbclass generates ${B}/extlinux.conf for the U-Boot
# build task (do_create_extlinux_config). ROOT, CONSOLE, FDT are required here.
# NOTE: the WIC bootimg-partition plugin ignores these variables and regenerates
# extlinux.conf independently; it is controlled by WKS bootloader --configfile
# (see meta-hmi-platform/wic/elevator-hmi-emmc.wks.in + elevator-hmi-extlinux.conf).
UBOOT_EXTLINUX = "1"
UBOOT_EXTLINUX_FDT = "/elevator-hmi-boardcon-em3566-v3.dtb"
UBOOT_EXTLINUX_CONSOLE = "console=ttyS2,1500000"
UBOOT_EXTLINUX_ROOT = "root=/dev/mmcblk0p2 rw rootfstype=ext4 rootwait"

# bootimg-partition WIC plugin reads IMAGE_BOOT_FILES to populate the vfat /boot
# partition. meta-rockchip does not set this variable. Deploy dir produces both
# files flat (Yocto kernel recipe strips the arch/arm64/boot/ prefix on deploy).
IMAGE_BOOT_FILES = "Image elevator-hmi-boardcon-em3566-v3.dtb"
```
